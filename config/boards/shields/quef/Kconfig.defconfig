## config/boards/shields/quef/Kconfig.defconfig
```kconfig
# Copyright (c) 2020 The ZMK Contributors
# SPDX-License-Identifier: MIT


if SHIELD_QUEF_LEFT

config ZMK_KEYBOARD_NAME
    default "quef"

config ZMK_SPLIT_ROLE_CENTRAL
    default y

endif

if SHIELD_QUEF_LEFT || SHIELD_QUEF_RIGHT

config ZMK_SPLIT
    default y

endif
```

## config/boards/shields/quef/Kconfig.shield
```kconfig
# Copyright (c) 2020 The ZMK Contributors
# SPDX-License-Identifier: MIT

config SHIELD_QUEF_LEFT
    def_bool $(shields_list_contains,quef_left)

config SHIELD_QUEF_RIGHT
    def_bool $(shields_list_contains,quef_right)
```

## config/west.yml
```yaml
manifest:
  remotes:
    - name: zmkfirmware
      url-base: https://github.com/zmkfirmware
    - name: caksoylar #rgb widget for xiao seeed
      url-base: https://github.com/caksoylar
    # support nice_oled and nice_epaper
  #    - name: mctechnology17
  #      url-base: https://github.com/mctechnology17
  projects:
    - name: zmk
      remote: zmkfirmware
      #revision: main
      revision: v0.3.0 #pin to 0.3 for now
      import: app/west.yml
    - name: zmk-rgbled-widget #rgb widget for xiao seeed
      remote: caksoylar
      revision: main
    # support nice_oled and nice_epaper
  #    - name: zmk-nice-oled
  #      remote: mctechnology17
  #      revision: main
  self:
    path: config
```
